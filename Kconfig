## Kconfig
```kconfig
config SENSORS_AM335X_BANDGAP
	tristate "Texas Instruments AM335x SoC temperature sensor"
	depends on SOC_AM33XX
	help
	  If you say yes here you get support for the temperature
	  sensor found on the AM335x line of SoCs from Texas Instruments.
```
